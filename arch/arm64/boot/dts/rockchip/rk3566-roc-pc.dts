// SPDX-License-Identifier: (GPL-2.0+ OR MIT)
/*
 * Copyright (c) 2020 Rockchip Electronics Co., Ltd.
 *
 */

 /dts-v1/;

#include "rk3566-roc-pc.dtsi"
/*
 * Select one of the three
 * using single camera xc7160 ----> rk3566-roc-pc-cam-8ms1m.dtsi
 * using dual camera gc2053/gc2093   ----> rk3566-roc-pc-cam-2ms2m.dtsi
 * using rk628d   ----> rk3566-roc-pc-tf-hdmi-mipi-rk628.dtsi
 */
#include "rk3566-roc-pc-cam-8ms1m.dtsi"
//#include "rk3566-roc-pc-cam-2ms2m.dtsi"
//#include "rk3566-roc-pc-tf-hdmi-mipi-rk628.dtsi"


/ {
    model = "ROC-RK3566-PC HDMI(Android)";
    compatible = "rockchip,rk3566-roc-pc", "rockchip,rk3566";
};
