// SPDX-License-Identifier: (GPL-2.0+ OR MIT)
/*
 * Copyright (c) 2020 Rockchip Electronics Co., Ltd.
 *
 */

 /dts-v1/;

#include "rk3566-firefly-cs-r2.dtsi"

/ {
    model = "Cluster-Server-R2(Android)";
    compatible = "rockchip,rk3566-firefly-server-sub", "rockchip,rk3566";
};
