// SPDX-License-Identifier: (GPL-2.0+ OR MIT)
/*
 * Copyright (c) 2020 Rockchip Electronics Co., Ltd.
 *
 */

 /dts-v1/;

#include "rk3568-firefly-roc-pc.dtsi"
/*
 *                               Select one of the three 
 * using single camera xc7160 ----> rk3568-firefly-roc-pc-cam-8ms1m.dtsi
 * using dual camera gc2053/gc2093   ----> rk3568-firefly-roc-pc-cam-2ms2m.dtsi
 * using hdmi-in module rk628d   ----> rk3568-firefly-roc-pc-tf-hdmi-mipi-rk628.dtsi
 */
#include "rk3568-firefly-roc-pc-cam-8ms1m.dtsi"
//#include "rk3568-firefly-roc-pc-cam-2ms2m.dtsi"
//#include "rk3568-firefly-roc-pc-tf-hdmi-mipi-rk628.dtsi"

/ {
    model = "ROC-RK3568-PC HDMI (Android)";
    compatible = "rockchip,rk3568-firefly-roc-pc", "rockchip,rk3568";

};

&route_hdmi {
    status = "okay";
    connect = <&vp0_out_hdmi>;
};
